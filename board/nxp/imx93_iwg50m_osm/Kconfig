## board/nxp/imx93_iwg50m_osm/Kconfig
```kconfig
if TARGET_IMX93_IWG50M_OSM

config SYS_BOARD
	default "imx93_iwg50m_osm"

config SYS_VENDOR
	default "nxp"

config SYS_CONFIG_NAME
	default "imx93_iwg50m_osm"

config IMX93_IWG50M_OSM_LPDDR4X
	bool "Using LPDDR4X Timing and PMIC voltage"
	default y
	select IMX9_LPDDR4X
	help
	  Select the LPDDR4X timing and 0.6V VDDQ

endif
```
